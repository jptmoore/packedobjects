## embedded/buildroot/libpackedobjects/Config.in
```kconfig
config BR2_PACKAGE_LIBPACKEDOBJECTS
	bool "libpackedobjects"
	select BR2_PACKAGE_LIBXML2
	help
	  XML Schema-based compression 

	  http://packedobjects.org
```

## embedded/buildroot/packedobjects/Config.in
```kconfig
config BR2_PACKAGE_PACKEDOBJECTS
	bool "packedobjects"
	select BR2_PACKAGE_LIBPACKEDOBJECTS
	help
	  XML Schema-based commandline compression tool 

	  http://packedobjects.org
```
